## app/boards/shields/am_hatsu_dongle/Kconfig.shield
```kconfig
# Copyright (c) 2024
# SPDX-License-Identifier: MIT

config SHIELD_AM_HATSU_DONGLE
	def_bool $(shields_list_contains,am_hatsu_dongle)
```
